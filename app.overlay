&i2c1 {
    ssd1306: ssd1306@3c {
         compatible = "solomon,ssd1306fb";
         reg = <0x3c>;
         status = "okay";
         height = <64>;
         width = <128>;
         segment-offset = <0>;
         page-offset = <0>;
         display-offset = <0>;
         multiplex-ratio = <63>;
         prechargep = <0x22>;
         com-invdir;
         segment-remap;
    };
};
